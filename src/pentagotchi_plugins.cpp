/*
 * pentagotchi_plugins.cpp
 *
 * MicroQuickJS host runtime + pentagotchi plugin bridge.
 *
 * The JS standard library used here is our own pentagotchi_stdlib (ROM tables
 * defined in lib/mquickjs/pentagotchi_stdlib_data.c, generated by
 * tools/mqjs-stdlib/). Every js_* symbol the tables reference is implemented
 * below with C linkage (see include/pentagotchi_plugins_api.h).
 *
 * Design notes:
 *  - The JS heap lives in PSRAM (fallback: internal RAM), 16-byte aligned.
 *  - Firmware events that can be raised from the WiFi RX ISR are queued in a
 *    little ring buffer and dispatched from poll() in the main loop.
 *  - Plugin instances are created with `new Plugin({...})` and tracked in a
 *    C array of JSGCRef (they must survive GC).
 */

#include <Arduino.h>
#include <ArduinoJson.h>
#include <FS.h>
#include <SD.h>

#include "pentagotchi_plugins.h"
#include "pentagotchi_internal.h"
#include "pentagotchi_app.h"
#include "pentagotchi_config.h"
#include "pentagotchi_events.h"
#include "pwn_ui.h"

#include "pentagotchi_plugins_api.h"

extern "C" {
extern const JSSTDLibraryDef pentagotchi_stdlib;
}

using namespace pentagotchi::detail;

/* ------------------------------------------------------------------ */
/* Engine output plumbing                                             */
/* ------------------------------------------------------------------ */

/* fetch a property of the global object (agent, ui, ...) */
static JSValue get_global_obj(JSContext *ctx, const char *name)
{
    JSValue g = JS_GetGlobalObject(ctx);
    return JS_GetPropertyStr(ctx, g, name);
}

static void serial_write_func(void *opaque, const void *buf, size_t buf_len)
{
    (void)opaque;
    if (gSerialEnabled)
        Serial.write(reinterpret_cast<const uint8_t *>(buf), buf_len);
}

static int64_t get_time_ms(void)
{
    return (int64_t)millis();
}

static int64_t get_date_ms(void)
{
    return (int64_t)millis();
}

static void dump_error(JSContext *ctx)
{
    JSValue obj = JS_GetException(ctx);
    JS_PrintValueF(ctx, obj, JS_DUMP_LONG);
    Serial.write("\n");
}

/* ------------------------------------------------------------------ */
/* REPL glue                                                           */
/* ------------------------------------------------------------------ */

JSValue js_print(JSContext *ctx, JSValue *this_val, int argc, JSValue *argv)
{
    int i;
    for (i = 0; i < argc; i++) {
        if (i != 0)
            Serial.write(' ');
        if (JS_IsString(ctx, argv[i])) {
            JSCStringBuf buf;
            size_t len;
            const char *str = JS_ToCStringLen(ctx, &len, argv[i], &buf);
            Serial.write(reinterpret_cast<const uint8_t *>(str), len);
        } else {
            JS_PrintValueF(ctx, argv[i], JS_DUMP_LONG);
        }
    }
    Serial.write('\n');
    return JS_UNDEFINED;
}

JSValue js_gc(JSContext *ctx, JSValue *this_val, int argc, JSValue *argv)
{
    JS_GC(ctx);
    return JS_UNDEFINED;
}

JSValue js_date_constructor(JSContext *ctx, JSValue *this_val,
                            int argc, JSValue *argv)
{
    double val;
    argc &= ~FRAME_CF_CTOR;
    if (argc == 0) {
        val = get_date_ms();
    } else if (argc == 1 && JS_IsNumber(ctx, argv[0])) {
        if (JS_ToNumber(ctx, &val, argv[0]))
            return JS_EXCEPTION;
    } else {
        return JS_ThrowTypeError(ctx, "unsupported Date() parameter");
    }
    return JS_NewDate(ctx, val);
}

JSValue js_date_now(JSContext *ctx, JSValue *this_val, int argc, JSValue *argv)
{
    return JS_NewInt64(ctx, get_date_ms());
}

JSValue js_performance_now(JSContext *ctx, JSValue *this_val, int argc, JSValue *argv)
{
    return JS_NewInt64(ctx, get_time_ms());
}

/* load a script file from the SD card */
JSValue js_load(JSContext *ctx, JSValue *this_val, int argc, JSValue *argv)
{
    JSCStringBuf buf_str;
    const char *filename;
    JSValue ret;
    fs::File f;
    int buf_len;

    if (argc < 1)
        return JS_ThrowTypeError(ctx, "load(): missing filename");
    filename = JS_ToCString(ctx, argv[0], &buf_str);
    if (!filename)
        return JS_EXCEPTION;
    f = SD.open(filename, FILE_READ);
    if (!f.isDirectory() && f) {
        buf_len = (int)f.size();
        uint8_t *buf = (uint8_t *)malloc(buf_len + 1);
        if (!buf) {
            f.close();
            return JS_ThrowOutOfMemory(ctx);
        }
        if (f.read(buf, (size_t)buf_len) != (size_t)buf_len) {
            free(buf);
            f.close();
            return JS_ThrowInternalError(ctx, "load(): short read on %s", filename);
        }
        buf[buf_len] = '\0';
        f.close();
        ret = JS_Eval(ctx, (const char *)buf, (size_t)buf_len, filename, JS_EVAL_STRIP_COL);
        free(buf);
    } else {
        if (f)
            f.close();
        return JS_ThrowInternalError(ctx, "load(): cannot open '%s'", filename);
    }
    return ret;
}

/* ------------------------------------------------------------------ */
/* Timers (embedded equivalent of the REPL's setTimeout/clearTimeout) */
/* ------------------------------------------------------------------ */

struct JSTimer {
    bool allocated = false;
    JSGCRef func;
    int64_t timeout; /* ms */
};
#define MAX_TIMERS 16
static JSTimer s_timer_list[MAX_TIMERS];

JSValue js_setTimeout(JSContext *ctx, JSValue *this_val, int argc, JSValue *argv)
{
    JSTimer *th;
    int delay, i;
    JSValue *pfunc;

    if (!JS_IsFunction(ctx, argv[0]))
        return JS_ThrowTypeError(ctx, "not a function");
    if (JS_ToInt32(ctx, &delay, argv[1]))
        return JS_EXCEPTION;
    for (i = 0; i < MAX_TIMERS; i++) {
        th = &s_timer_list[i];
        if (!th->allocated) {
            pfunc = JS_AddGCRef(ctx, &th->func);
            *pfunc = argv[0];
            th->timeout = get_time_ms() + delay;
            th->allocated = true;
            return JS_NewInt32(ctx, i);
        }
    }
    return JS_ThrowInternalError(ctx, "too many timers");
}

JSValue js_clearTimeout(JSContext *ctx, JSValue *this_val, int argc, JSValue *argv)
{
    int timer_id;
    JSTimer *th;

    if (JS_ToInt32(ctx, &timer_id, argv[0]))
        return JS_EXCEPTION;
    if (timer_id >= 0 && timer_id < MAX_TIMERS) {
        th = &s_timer_list[timer_id];
        if (th->allocated) {
            JS_DeleteGCRef(ctx, &th->func);
            th->allocated = false;
        }
    }
    return JS_UNDEFINED;
}

static void run_timers(JSContext *ctx)
{
    int i;
    JSTimer *th;
    int64_t cur_time = get_time_ms();

    for (i = 0; i < MAX_TIMERS; i++) {
        th = &s_timer_list[i];
        if (th->allocated && th->timeout <= cur_time) {
            JSValue ret;
            if (JS_StackCheck(ctx, 2)) {
                dump_error(ctx);
                JSValue id = JS_NewInt32(ctx, i);
                js_clearTimeout(ctx, NULL, 1, &id);
                continue;
            }
            JS_PushArg(ctx, th->func.val); /* func */
            JS_PushArg(ctx, JS_NULL);      /* this */
            JS_DeleteGCRef(ctx, &th->func);
            th->allocated = false;
            ret = JS_Call(ctx, 0);
            if (JS_IsException(ret)) {
                dump_error(ctx);
            }
        }
    }
}

/* ------------------------------------------------------------------ */
/* Plugin registry                                                     */
/* ------------------------------------------------------------------ */

#define MAX_PLUGINS 8

struct PluginSlot {
    bool used = false;
    JSGCRef ref;
};
static PluginSlot s_plugins[MAX_PLUGINS];
static int s_plugin_count = 0;
static int32_t s_epoch = 0;

/* per-plugin configuration persisted to the SD card (/plugins.json) */
static const char *kPluginConfigPath = "/plugins.json";
static JsonDocument s_pluginConfig;       /* { "plugins": { "<name>": { enabled, options } } } */
static bool s_pluginConfigDirty = false;
static char s_currentPluginFile[64] = {0}; /* name of the file being evaluated */

static bool plugin_config_entry_is_new(JsonObject root, const char *name)
{
    return !root[name].is<JsonObject>();
}

/* "/plugins/example.js" -> "example"; also just "example.js" -> "example" */
static void plugin_name_simple(const String &path, char *out, size_t cap)
{
    String name = path;
    int slash = name.lastIndexOf('/');
    if (slash >= 0)
        name = name.substring(slash + 1);
    if (name.endsWith(".js"))
        name = name.substring(0, name.length() - 3);
    strncpy(out, name.c_str(), cap - 1);
    out[cap - 1] = '\0';
}

/* serialize a JS value to a JSON string (used to store plugin options) */
static bool js_value_to_json(JSContext *ctx, JSValue val, char *out, size_t cap)
{
    JSGCRef val_ref;
    JS_PUSH_VALUE(ctx, val);
    JSValue argv[1];
    argv[0] = val;
    JSValue ret = js_json_stringify(ctx, NULL, 1, argv);
    JS_POP_VALUE(ctx, val);
    if (JS_IsException(ret))
        return false;
    JSCStringBuf b;
    const char *s = JS_ToCString(ctx, ret, &b);
    if (!s)
        return false;
    strncpy(out, s, cap > 0 ? cap - 1 : 0);
    if (cap > 0)
        out[cap - 1] = '\0';
    return true;
}

static void load_plugin_config()
{
    s_pluginConfig.clear();
    if (!SD.exists(kPluginConfigPath)) {
        s_pluginConfigDirty = true; /* plugin list will be created on save */
        return;
    }
    fs::File f = SD.open(kPluginConfigPath, FILE_READ);
    if (!f) {
        s_pluginConfigDirty = true;
        return;
    }
    deserializeJson(s_pluginConfig, f);
    f.close();
}

static void save_plugin_config()
{
    if (!s_pluginConfigDirty)
        return;
    fs::File f = SD.open(kPluginConfigPath, FILE_WRITE);
    if (!f) {
        SERIAL_PRINTF("[plugins] cannot write %s\n", kPluginConfigPath);
        return;
    }
    serializeJsonPretty(s_pluginConfig, f);
    f.close();
    s_pluginConfigDirty = false;
    SERIAL_PRINTF("[plugins] saved %s\n", kPluginConfigPath);
}

/* ------------------------------------------------------------------ */
/* Plugin construction: enabled flag + options from /plugins.json      */
/* ------------------------------------------------------------------ */

static void set_plugin_options_prop(JSContext *ctx, JSValue *this_val,
                                    const JsonObject &entry)
{
    if (!entry["options"].is<JsonObject>())
        return;
    char buf[768];
    size_t n = serializeJson(entry["options"], buf, sizeof(buf));
    (void)n;
    JSValue arg = JS_NewString(ctx, buf);
    JSGCRef arg_ref;
    JS_PUSH_VALUE(ctx, arg);
    JSValue arg_dup = arg;
    JSValue opts = js_json_parse(ctx, NULL, 1, &arg_dup);
    JS_POP_VALUE(ctx, arg);
    if (JS_IsException(opts))
        return;
    JSGCRef opts_ref;
    JS_PUSH_VALUE(ctx, opts);
    JS_SetPropertyStr(ctx, *this_val, "options", opts);
    JS_POP_VALUE(ctx, opts);
}

/* mquickjs does not export JS_IsObject; treat everything that is not
   undefined/null/exception as an object-like value */
static bool js_is_object_like(JSValue v)
{
    return !JS_IsNull(v) && !JS_IsUndefined(v) && !JS_IsException(v);
}

JSValue js_pwn_plugin(JSContext *ctx, JSValue *this_val, int argc, JSValue *argv)
{
    /* new Plugin({...}) */
    argc &= ~FRAME_CF_CTOR;
    if (argc < 1)
        return JS_ThrowTypeError(ctx, "Plugin() requires an options object");

    JSValue options = argv[0];

    /* ------------------------------------------------ */
    /* resolve plugin name from the current script file  */
    /* ------------------------------------------------ */
    char pluginName[32];
    if (s_currentPluginFile[0])
        plugin_name_simple(String(s_currentPluginFile), pluginName, sizeof(pluginName));
    else
        snprintf(pluginName, sizeof(pluginName), "plugin%u", (unsigned)s_plugin_count);

    /* ------------------------------------------------ */
    /* read declared defaults (__defaults__ or options)  */
    /* ------------------------------------------------ */
    JSValue defs = JS_GetPropertyStr(ctx, options, "__defaults__");
    JSValue defOpts = JS_GetPropertyStr(ctx, options, "options");
    JSValue declOptions = JS_UNDEFINED;
    if (js_is_object_like(defs)) {
        declOptions = JS_GetPropertyStr(ctx, defs, "options");
        if (!js_is_object_like(declOptions))
            declOptions = JS_UNDEFINED;
    } else if (js_is_object_like(defOpts)) {
        declOptions = defOpts;
    }

    /* ------------------------------------------------ */
    /* update /plugins.json entry for this plugin        */
    /* ------------------------------------------------ */
    JsonObject root = s_pluginConfig["plugins"].to<JsonObject>();
    bool isNew = plugin_config_entry_is_new(root, pluginName);
    JsonObject entry = root[pluginName].to<JsonObject>();
    if (isNew) {
        entry["enabled"] = false; /* plugins start disabled */
        if (!JS_IsUndefined(declOptions)) {
            char buf[768];
            if (js_value_to_json(ctx, declOptions, buf, sizeof(buf))) {
                JsonDocument tmp;
                if (deserializeJson(tmp, buf) == DeserializationError::Ok) {
                    JsonObject opt = entry["options"].to<JsonObject>();
                    for (JsonPair kv : tmp.as<JsonObject>())
                        opt[kv.key()] = kv.value();
                } else {
                    entry.remove("options");
                }
            }
        }
        s_pluginConfigDirty = true;
        SERIAL_PRINTF("[plugins] new plugin '%s' added to %s\n",
                      pluginName, kPluginConfigPath);
    }

    bool enabled = entry["enabled"] | false;
    SERIAL_PRINTF("[plugins] plugin '%s' %s\n",
                  pluginName, enabled ? "enabled" : "disabled");

    /* merge config options back into the instance so hooks can read
       this.options.* ; fall back to the declared defaults object */
    if (entry["options"].is<JsonObject>()) {
        set_plugin_options_prop(ctx, this_val, entry);
    } else if (js_is_object_like(declOptions)) {
        JSGCRef declOptions_ref;
        JS_PUSH_VALUE(ctx, declOptions);
        JS_SetPropertyStr(ctx, *this_val, "options", declOptions);
        JS_POP_VALUE(ctx, declOptions);
    }

    /* disabled plugins are not registered: no hooks, no on_loaded */
    if (!enabled)
        return *this_val;

    /* copy own properties from the options object onto the instance */
    static const char *const kKeys[] = {
        "__author__", "__version__", "__license__", "__description__",
        "on_loaded", "on_unload", "on_ui_setup", "on_ui_update",
        "on_ready", "on_epoch", "on_channel_hop",
        "on_ap_detected", "on_wifi_update",
        "on_handshake", "on_deauthentication",
        "on_peer_detected", "on_peer_encounter", "on_peer_lost", "on_friend",
    };
    for (size_t k = 0; k < sizeof(kKeys) / sizeof(kKeys[0]); k++) {
        JSValue v = JS_GetPropertyStr(ctx, options, kKeys[k]);
        if (JS_IsException(v))
            return JS_EXCEPTION;
        if (!JS_IsUndefined(v) && !JS_IsNull(v)) {
            JSValue ret = JS_SetPropertyStr(ctx, *this_val, kKeys[k], v);
            if (JS_IsException(ret))
                return ret;
        }
    }

    if (s_plugin_count >= MAX_PLUGINS)
        return JS_ThrowInternalError(ctx, "too many plugins");
    JSValue *slot = JS_AddGCRef(ctx, &s_plugins[s_plugin_count].ref);
    *slot = *this_val;
    s_plugins[s_plugin_count].used = true;
    s_plugin_count++;

    /* pwnagotchi semantics: on_loaded(agent) fires as soon as the plugin is
       created, before any firmware event is dispatched. */
    JSValue loaded = JS_GetPropertyStr(ctx, *this_val, "on_loaded");
    if (JS_IsException(loaded)) {
        dump_error(ctx);
    } else if (JS_IsFunction(ctx, loaded)) {
        JSValue agent = get_global_obj(ctx, "agent");
        if (JS_StackCheck(ctx, 3)) {
            dump_error(ctx);
        } else {
            JS_PushArg(ctx, agent);
            JS_PushArg(ctx, loaded);
            JS_PushArg(ctx, *this_val);
            JSValue ret = JS_Call(ctx, 1);
            if (JS_IsException(ret))
                dump_error(ctx);
        }
    }
    return *this_val;
}

/* ------------------------------------------------------------------ */
/* agent global                                                       */
/* ------------------------------------------------------------------ */

JSValue js_pwn_agent_get_identity(JSContext *ctx, JSValue *this_val, int argc, JSValue *argv)
{
    const char *name = "pentagotchi";
    if (gInstance)
        name = gInstance->config().name;
    return JS_NewString(ctx, name);
}

JSValue js_pwn_agent_get_epoch(JSContext *ctx, JSValue *this_val, int argc, JSValue *argv)
{
    return JS_NewInt32(ctx, s_epoch);
}

JSValue js_pwn_agent_get_config(JSContext *ctx, JSValue *this_val, int argc, JSValue *argv)
{
    JSGCRef cfg_ref, o_ref;
    JSValue cfg;

    if (!gInstance)
        return JS_NewObject(ctx);
    const pentagotchi_config_t &c = gInstance->config();

    cfg = JS_NewObject(ctx);
    JS_PUSH_VALUE(ctx, cfg);

    JSValue o = JS_NewObject(ctx);
    JS_PUSH_VALUE(ctx, o);
#define SET_STR(tgt, key, val) do { JSValue s = JS_NewString(ctx, (val)); JSGCRef s_ref; JS_PUSH_VALUE(ctx, s); JS_SetPropertyStr(ctx, (tgt), (key), s); JS_POP_VALUE(ctx, s); } while (0)
#define SET_INT(tgt, key, val) do { JS_SetPropertyStr(ctx, (tgt), (key), JS_NewInt32(ctx, (val))); } while (0)
#define SET_BOOL(tgt, key, val) do { JS_SetPropertyStr(ctx, (tgt), (key), JS_NewBool((val))); } while (0)

    SET_STR(cfg, "name", c.name);
    SET_STR(cfg, "lang", c.lang);
    SET_BOOL(cfg, "grid_enabled", c.grid_enabled);
    SET_BOOL(cfg, "gps_enabled", c.gps_enabled);
    SET_BOOL(cfg, "deauth_enabled", c.deauth_enabled);
    SET_BOOL(cfg, "serial", c.serial);
    SET_INT(cfg, "uptime", (int32_t)gInstance->uptimeSec());
    SET_INT(cfg, "epoch", s_epoch);
    SET_INT(cfg, "handshakes", gHandshakeCount);
    SET_INT(cfg, "total_pwnd", (int32_t)gInstance->stats().total_pwnd);
    SET_INT(cfg, "total_aps", (int32_t)gInstance->stats().total_aps);

    SET_BOOL(o, "enabled", c.display.enabled);
    SET_STR(o, "rotation", c.display.rotation);
    SET_STR(o, "type", c.display.type);
    SET_STR(o, "color", c.display.color);
    JS_SetPropertyStr(ctx, cfg, "display", o);
    JS_POP_VALUE(ctx, o);

    JS_POP_VALUE(ctx, cfg);
    return cfg;
#undef SET_STR
#undef SET_INT
#undef SET_BOOL
}

JSValue js_pwn_agent_set_face(JSContext *ctx, JSValue *this_val, int argc, JSValue *argv)
{
    JSCStringBuf buf;
    const char *s = JS_ToCString(ctx, argv[0], &buf);
    if (s)
        pwn_ui_set_face(s);
    return JS_UNDEFINED;
}

JSValue js_pwn_agent_set_status(JSContext *ctx, JSValue *this_val, int argc, JSValue *argv)
{
    JSCStringBuf buf;
    const char *s = JS_ToCString(ctx, argv[0], &buf);
    if (s)
        pwn_ui_set_status(s);
    return JS_UNDEFINED;
}

JSValue js_pwn_agent_set_mode(JSContext *ctx, JSValue *this_val, int argc, JSValue *argv)
{
    JSCStringBuf buf;
    const char *s = JS_ToCString(ctx, argv[0], &buf);
    if (s)
        pwn_ui_set_mode(s);
    return JS_UNDEFINED;
}

JSValue js_pwn_agent_run(JSContext *ctx, JSValue *this_val, int argc, JSValue *argv)
{
    return JS_UNDEFINED;
}

/* ------------------------------------------------------------------ */
/* ui global                                                          */
/* ------------------------------------------------------------------ */

JSValue js_pwn_ui_get_status(JSContext *ctx, JSValue *this_val, int argc, JSValue *argv)
{
    return JS_NewString(ctx, pwn_ui_get_status());
}

JSValue js_pwn_ui_set_status(JSContext *ctx, JSValue *this_val, int argc, JSValue *argv)
{
    JSCStringBuf buf;
    const char *s = JS_ToCString(ctx, argv[0], &buf);
    if (s)
        pwn_ui_set_status(s);
    return JS_UNDEFINED;
}

JSValue js_pwn_ui_set(JSContext *ctx, JSValue *this_val, int argc, JSValue *argv)
{
    JSValue v;
    JSCStringBuf buf_key, buf_val;
    const char *key, *val;

    if (argc < 2)
        return JS_UNDEFINED;
    key = JS_ToCString(ctx, argv[0], &buf_key);
    if (!key)
        return JS_EXCEPTION;

    v = JS_ToString(ctx, argv[1]);
    if (JS_IsException(v))
        return JS_EXCEPTION;
    val = JS_ToCString(ctx, v, &buf_val);
    if (!val)
        return JS_EXCEPTION;

    if (!strcmp(key, "channel")) pwn_ui_set_channel(val);
    else if (!strcmp(key, "aps")) pwn_ui_set_aps(val);
    else if (!strcmp(key, "uptime")) pwn_ui_set_uptime(val);
    else if (!strcmp(key, "face")) pwn_ui_set_face(val);
    else if (!strcmp(key, "name")) pwn_ui_set_name(val);
    else if (!strcmp(key, "status")) pwn_ui_set_status(val);
    else if (!strcmp(key, "shakes")) pwn_ui_set_shakes(val);
    else if (!strcmp(key, "mode")) pwn_ui_set_mode(val);
    else if (gSerialEnabled) {
        Serial.printf("[plugins] ui.set: unknown element '%s'\n", key);
    }
    return JS_UNDEFINED;
}

JSValue js_pwn_ui_get(JSContext *ctx, JSValue *this_val, int argc, JSValue *argv)
{
    JSCStringBuf buf;
    const char *key;
    const char *res = "";

    if (argc < 1)
        return JS_NewString(ctx, "");
    key = JS_ToCString(ctx, argv[0], &buf);
    if (!key)
        return JS_EXCEPTION;

    if (!strcmp(key, "channel")) res = pwn_ui_get_channel();
    else if (!strcmp(key, "aps")) res = pwn_ui_get_aps();
    else if (!strcmp(key, "uptime")) res = pwn_ui_get_uptime();
    else if (!strcmp(key, "face")) res = pwn_ui_get_face();
    else if (!strcmp(key, "name")) res = pwn_ui_get_name();
    else if (!strcmp(key, "status")) res = pwn_ui_get_status();
    else if (!strcmp(key, "shakes")) res = pwn_ui_get_shakes();
    else if (!strcmp(key, "mode")) res = pwn_ui_get_mode();
    return JS_NewString(ctx, res);
}

/* ------------------------------------------------------------------ */
/* faces global                                                        */
/* ------------------------------------------------------------------ */

static const char *const kFaces[] = {
    PWN_FACE_AWAKE,       /* 0 */
    PWN_FACE_SLEEP,       /* 1 */
    PWN_FACE_SLEEP2,      /* 2 */
    PWN_FACE_BORED,       /* 3 */
    PWN_FACE_INTENSE,     /* 4 */
    PWN_FACE_COOL,        /* 5 */
    PWN_FACE_HAPPY,       /* 6 */
    PWN_FACE_GRATEFUL,    /* 7 */
    PWN_FACE_EXCITED,     /* 8 */
    PWN_FACE_MOTIVATED,   /* 9 */
    PWN_FACE_DEMOTIVATED, /* 10 */
    PWN_FACE_SMART,       /* 11 */
    PWN_FACE_LONELY,      /* 12 */
    PWN_FACE_SAD,         /* 13 */
    PWN_FACE_ANGRY,       /* 14 */
    PWN_FACE_FRIEND,      /* 15 */
    PWN_FACE_BROKEN,      /* 16 */
    PWN_FACE_DEBUG,       /* 17 */
    PWN_FACE_UPLOAD,      /* 18 */
    PWN_FACE_LOOK_L,      /* 19 */
    PWN_FACE_LOOK_R,      /* 20 */
    PWN_FACE_LOOK_L_HAPPY,/* 21 */
    PWN_FACE_LOOK_R_HAPPY,/* 22 */
};

JSValue js_pwn_face_get(JSContext *ctx, JSValue *this_val, int argc, JSValue *argv, int magic)
{
    const char *s = "(-_-)";
    if (magic >= 0 && magic < (int)(sizeof(kFaces) / sizeof(kFaces[0])))
        s = kFaces[magic];
    return JS_NewString(ctx, s);
}

/* ------------------------------------------------------------------ */
/* Event dispatch                                                      */
/* ------------------------------------------------------------------ */

namespace {

struct PendingEvent {
    uint8_t used;
    pwn_event_id_t id;
    int32_t value;
    int32_t rssi;
    uint8_t mac[6];
    char str[48];
};

#define EVENT_QUEUE_SIZE 8
static PendingEvent s_queue[EVENT_QUEUE_SIZE];
static portMUX_TYPE s_queueMux = portMUX_INITIALIZER_UNLOCKED;

void build_ap_object(JSContext *ctx, const uint8_t *mac, int rssi, int channel,
                     const char *ssid, JSValue out)
{
    char macstr[18];
    if (mac) {
        macToString(mac).toCharArray(macstr, sizeof(macstr));
        JSValue s = JS_NewString(ctx, macstr);
        JSGCRef s_ref;
        JS_PUSH_VALUE(ctx, s);
        JS_SetPropertyStr(ctx, out, "bssid", s);
        JS_POP_VALUE(ctx, s);
    }
    JS_SetPropertyStr(ctx, out, "rssi", JS_NewInt32(ctx, rssi));
    JS_SetPropertyStr(ctx, out, "channel", JS_NewInt32(ctx, channel));
    if (ssid && ssid[0]) {
        JSValue s = JS_NewString(ctx, ssid);
        JSGCRef s_ref;
        JS_PUSH_VALUE(ctx, s);
        JS_SetPropertyStr(ctx, out, "ssid", s);
        JS_POP_VALUE(ctx, s);
    }
}

void build_client_object(JSContext *ctx, const uint8_t *mac, int rssi, int channel, JSValue out)
{
    if (mac) {
        char macstr[18];
        macToString(mac).toCharArray(macstr, sizeof(macstr));
        JSValue s = JS_NewString(ctx, macstr);
        JSGCRef s_ref;
        JS_PUSH_VALUE(ctx, s);
        JS_SetPropertyStr(ctx, out, "mac", s);
        JS_POP_VALUE(ctx, s);
    }
    JS_SetPropertyStr(ctx, out, "signal", JS_NewInt32(ctx, rssi));
    JS_SetPropertyStr(ctx, out, "channel", JS_NewInt32(ctx, channel));
}

void build_peer_object(JSContext *ctx, const char *name, int32_t value, int32_t rssi, JSValue out)
{
    if (name && name[0]) {
        JSValue s = JS_NewString(ctx, name);
        JSGCRef s_ref;
        JS_PUSH_VALUE(ctx, s);
        JS_SetPropertyStr(ctx, out, "identity", s);
        JS_SetPropertyStr(ctx, out, "name", s);
        JS_POP_VALUE(ctx, s);
    }
    /* fill real data from the grid when available */
    String closestFace, closestName;
    uint32_t cSession = 0, cTotal = 0;
    int cRssi = -1000;
    if (pentagotchi_grid_closest_peer(closestFace, closestName, cSession, cTotal, cRssi)) {
        if (!closestFace.isEmpty()) {
            JSValue s = JS_NewString(ctx, closestFace.c_str());
            JSGCRef s_ref;
            JS_PUSH_VALUE(ctx, s);
            JS_SetPropertyStr(ctx, out, "face", s);
            JS_POP_VALUE(ctx, s);
        }
        if (!closestName.isEmpty()) {
            JSValue s = JS_NewString(ctx, closestName.c_str());
            JSGCRef s_ref;
            JS_PUSH_VALUE(ctx, s);
            JS_SetPropertyStr(ctx, out, "name", s);
            JS_POP_VALUE(ctx, s);
        }
        JS_SetPropertyStr(ctx, out, "rssi", JS_NewInt32(ctx, cRssi));
        JS_SetPropertyStr(ctx, out, "pwnd_session", JS_NewInt32(ctx, (int32_t)cSession));
        JS_SetPropertyStr(ctx, out, "pwnd_total", JS_NewInt32(ctx, (int32_t)cTotal));
    } else {
        JS_SetPropertyStr(ctx, out, "rssi", JS_NewInt32(ctx, rssi));
    }
    JS_SetPropertyStr(ctx, out, "encounters", JS_NewInt32(ctx, value));
    return;
}

/* call on_<hook> for every plugin, passing argc argv to each instance.
   JS_Call expects the arguments pushed in reverse order (arg[n-1] ...
   arg[0]), then the function, then the 'this' object. */
void call_hooks(JSContext *ctx, const char *hook,
                int argc, JSValue *argv)
{
    for (int i = 0; i < s_plugin_count; i++) {
        PluginSlot &slot = s_plugins[i];
        if (!slot.used)
            continue;
        JSValue plugin = slot.ref.val;
        JSValue func = JS_GetPropertyStr(ctx, plugin, hook);
        if (JS_IsException(func)) {
            dump_error(ctx);
            continue;
        }
        if (!JS_IsFunction(ctx, func))
            continue;
        if (JS_StackCheck(ctx, argc + 2)) {
            dump_error(ctx);
            continue;
        }
        for (int a = argc - 1; a >= 0; a--)
            JS_PushArg(ctx, argv[a]);
        JS_PushArg(ctx, func);
        JS_PushArg(ctx, plugin);
        JSValue ret = JS_Call(ctx, argc);
        if (JS_IsException(ret)) {
            dump_error(ctx);
        }
    }
}

/* Dispatch a single event copied from the firmware bus. Builds the hook
   arguments as GC-rooted JSValues, calls every plugin's handler, then pops
   the roots. agent/ui are properties of the global object (always
   reachable), the rest are transient and must be rooted. */
void dispatch_event(JSContext *ctx, const PendingEvent &ev)
{
    JSValue agent = get_global_obj(ctx, "agent");
    JSValue ui = get_global_obj(ctx, "ui");

    JSValue args[4];
    JSGCRef args_ref[4];
    int nargs = 0;

    /* root an argument as soon as it is produced so transient objects
       (ap, client, peer, strings) survive any GC triggered while the
       argument objects are being built */
    auto add_arg = [&](JSValue v) {
        args[nargs] = v;
        *JS_PushGCRef(ctx, &args_ref[nargs]) = v;
        nargs++;
    };

    const char *hook = "";
    switch (ev.id) {
    case PWN_EVENT_BOOT:
        hook = "on_ready";
        add_arg(agent);
        break;
    case PWN_EVENT_SCAN_CYCLE:
        hook = "on_epoch";
        s_epoch++;
        add_arg(agent);
        add_arg(JS_NewInt32(ctx, ev.value > 0 ? ev.value : readWifiChannel()));
        break;
    case PWN_EVENT_CHANNEL_CHANGED:
        hook = "on_channel_hop";
        add_arg(agent);
        add_arg(JS_NewInt32(ctx, ev.value));
        break;
    case PWN_EVENT_AP_DETECTED:
    case PWN_EVENT_DEAUTH_SENT: {
        hook = (ev.id == PWN_EVENT_AP_DETECTED) ? "on_ap_detected" : "on_deauthentication";
        JSValue ap = JS_NewObject(ctx);
        add_arg(ap);
        const char *ssid = nullptr;
        if (ev.id == PWN_EVENT_AP_DETECTED) {
            /* look up ssid for the new beacon */
            BeaconEntry probe;
            memset(&probe, 0, sizeof(probe));
            if (ev.mac) memcpy(probe.mac, ev.mac, 6);
            portENTER_CRITICAL(&gRadioMux);
            auto it = gRegisteredBeacons.find(probe);
            if (it != gRegisteredBeacons.end())
                ssid = it->ssid;
            portEXIT_CRITICAL(&gRadioMux);
        }
        build_ap_object(ctx, ev.mac, ev.rssi, ev.value, ssid, ap);
        if (ev.id == PWN_EVENT_DEAUTH_SENT) {
            JSValue client = JS_NewObject(ctx);
            add_arg(client);
            build_client_object(ctx, ev.mac, ev.rssi, ev.value, client);
        }
        break;
    }
    case PWN_EVENT_HANDSHAKE: {
        hook = "on_handshake";
        JSValue ap = JS_NewObject(ctx);
        add_arg(ap);
        build_ap_object(ctx, nullptr, 0, readWifiChannel(), nullptr, ap);
        JSValue client = JS_NewObject(ctx);
        add_arg(client);
        build_client_object(ctx, nullptr, 0, 0, client);
        char filename[64];
        if (!gLastPwndName.isEmpty()) {
            String macnum = gLastPwndName;
            macnum.replace(":", "");
            snprintf(filename, sizeof(filename), "/Handshakes/HS_%s.pcap", macnum.c_str());
        } else {
            snprintf(filename, sizeof(filename), "/Handshakes/HS_%d.pcap", gHandshakeCount);
        }
        add_arg(JS_NewString(ctx, filename));
        break;
    }
    case PWN_EVENT_PEER_DETECTED:
    case PWN_EVENT_PEER_ENCOUNTER:
    case PWN_EVENT_PEER_GONE:
    case PWN_EVENT_FRIEND: {
        const char *peer_hooks[] = { "on_peer_detected", "on_peer_encounter",
                                     "on_peer_lost", "on_friend" };
        hook = peer_hooks[ev.id - PWN_EVENT_PEER_DETECTED];
        JSValue peer = JS_NewObject(ctx);
        add_arg(peer);
        build_peer_object(ctx, ev.str, ev.value, ev.rssi, peer);
        break;
    }
    case PWN_EVENT_MOOD_CHANGED:
        hook = "on_ui_update";
        add_arg(ui);
        break;
    case PWN_EVENT_STATS_CLEARED:
    default:
        hook = "";
        break;
    }

    if (hook[0] != '\0')
        call_hooks(ctx, hook, nargs, args);

    /* pop roots in reverse order */
    for (int i = nargs - 1; i >= 0; i--)
        JS_PopGCRef(ctx, &args_ref[i]);
}

} // namespace

/* ------------------------------------------------------------------ */
/* Firmware event bus -> queue -> poll()                              */
/* ------------------------------------------------------------------ */

static void plugins_on_event(const pwn_event_t *ev)
{
    if (!ev)
        return;
    portENTER_CRITICAL(&s_queueMux);
    for (int i = 0; i < EVENT_QUEUE_SIZE; i++) {
        PendingEvent *pe = &s_queue[i];
        if (!pe->used) {
            memset(pe, 0, sizeof(*pe));
            pe->used = 1;
            pe->id = ev->id;
            pe->value = ev->value;
            pe->rssi = ev->rssi;
            if (ev->mac) memcpy(pe->mac, ev->mac, 6);
            if (ev->str) {
                strncpy(pe->str, ev->str, sizeof(pe->str) - 1);
                pe->str[sizeof(pe->str) - 1] = '\0';
            }
            break;
        }
    }
    portEXIT_CRITICAL(&s_queueMux);
}

/* ------------------------------------------------------------------ */
/* PentagotchiPlugins implementation                                  */
/* ------------------------------------------------------------------ */

void PentagotchiPlugins::begin()
{
    if (ctx_)
        return;

    const size_t heapSize = 1024 * 1024; /* plugins run in PSRAM */
    size_t allocSize = heapSize + 16;
    uint8_t *heap = nullptr;
    heap = (uint8_t *)heap_caps_aligned_alloc(16, allocSize, MALLOC_CAP_SPIRAM);
    if (!heap) {
        heap = (uint8_t *)heap_caps_aligned_alloc(16, allocSize, MALLOC_CAP_8BIT);
    }
    if (!heap) {
        SERIAL_PRINTLN("[plugins] failed to allocate JS heap");
        return;
    }
    heap_ = heap;
    heapAllocated_ = 1;

    JSContext *ctx = JS_NewContext2(heap, heapSize, &pentagotchi_stdlib, 0);
    if (!ctx) {
        heap_caps_free(heap);
        heap_ = nullptr;
        heapAllocated_ = 0;
        SERIAL_PRINTLN("[plugins] JS context init failed");
        return;
    }
    ctx_ = ctx;

    JS_SetLogFunc(ctx, serial_write_func);
    JS_SetContextOpaque(ctx, gInstance);

    pwn_events_subscribe(PWN_EVENT_BOOT, plugins_on_event, "plugins_boot");
    pwn_events_subscribe(PWN_EVENT_SCAN_CYCLE, plugins_on_event, "plugins_scan");
    pwn_events_subscribe(PWN_EVENT_CHANNEL_CHANGED, plugins_on_event, "plugins_ch");
    pwn_events_subscribe(PWN_EVENT_AP_DETECTED, plugins_on_event, "plugins_ap");
    pwn_events_subscribe(PWN_EVENT_HANDSHAKE, plugins_on_event, "plugins_hs");
    pwn_events_subscribe(PWN_EVENT_DEAUTH_SENT, plugins_on_event, "plugins_deauth");
    pwn_events_subscribe(PWN_EVENT_PEER_DETECTED, plugins_on_event, "plugins_peer");
    pwn_events_subscribe(PWN_EVENT_PEER_ENCOUNTER, plugins_on_event, "plugins_enc");
    pwn_events_subscribe(PWN_EVENT_PEER_GONE, plugins_on_event, "plugins_gone");
    pwn_events_subscribe(PWN_EVENT_FRIEND, plugins_on_event, "plugins_friend");
    pwn_events_subscribe(PWN_EVENT_MOOD_CHANGED, plugins_on_event, "plugins_mood");

    /* Load /plugins/*.js from the SD card */
    if (!SD.exists("/plugins")) {
        if (SD.mkdir("/plugins"))
            SERIAL_PRINTF("[plugins] created /plugins/\n");
        else
            SERIAL_PRINTF("[plugins] cannot create /plugins/\n");
    }
    load_plugin_config();
    SERIAL_PRINTF("[plugins] loading /plugins/\n");
    fs::File dir = SD.open("/plugins");
    if (dir && dir.isDirectory()) {
        fs::File f = dir.openNextFile();
        while (f) {
            String name = f.name();
            if (!f.isDirectory() && name.endsWith(".js")) {
                int len = (int)f.size();
                uint8_t *buf = (uint8_t *)malloc(len + 1);
                if (buf && f.read(buf, (size_t)len) == (size_t)len) {
                    buf[len] = '\0';
                    SERIAL_PRINTF("[plugins] load %s\n", name.c_str());
                    snprintf(s_currentPluginFile, sizeof(s_currentPluginFile),
                             "%s", name.c_str());
                    JSValue v = JS_Eval(ctx, (const char *)buf, (size_t)len, name.c_str(), JS_EVAL_STRIP_COL);
                    s_currentPluginFile[0] = '\0';
                    if (JS_IsException(v)) {
                        SERIAL_PRINTF("[plugins] error in %s:\n", name.c_str());
                        dump_error(ctx);
                    }
                }
                if (buf)
                    free(buf);
                f.close();
            }
            f = dir.openNextFile();
        }
        dir.close();
    } else {
        if (dir)
            dir.close();
        SERIAL_PRINTF("[plugins] no /plugins dir on SD\n");
    }

    /* persist any newly discovered plugin entries / default options */
    save_plugin_config();

    SERIAL_PRINTF("[plugins] ready, %d plugin(s), heap %u KB\n",
                  s_plugin_count, (unsigned)(heapSize / 1024));
}

void PentagotchiPlugins::poll()
{
    if (!ctx_)
        return;

    /* Drain queued firmware events */
    for (int pass = 0; pass < EVENT_QUEUE_SIZE; pass++) {
        PendingEvent *pe = nullptr;
        portENTER_CRITICAL(&s_queueMux);
        for (int i = 0; i < EVENT_QUEUE_SIZE; i++) {
            if (s_queue[i].used) {
                pe = &s_queue[i];
                break;
            }
        }
        if (pe)
            pe->used = 0;
        portEXIT_CRITICAL(&s_queueMux);

        if (!pe)
            break;
        dispatch_event((JSContext *)ctx_, *pe);
    }

    run_timers((JSContext *)ctx_);
}

void PentagotchiPlugins::unloadAll()
{
    if (!ctx_)
        return;
    JSContext *ctx = (JSContext *)ctx_;
    for (int i = 0; i < s_plugin_count; i++) {
        if (s_plugins[i].used)
            JS_DeleteGCRef(ctx, &s_plugins[i].ref);
        s_plugins[i].used = false;
    }
    s_plugin_count = 0;
    for (int i = 0; i < MAX_TIMERS; i++) {
        if (s_timer_list[i].allocated) {
            JS_DeleteGCRef(ctx, &s_timer_list[i].func);
            s_timer_list[i].allocated = false;
        }
    }
    JS_FreeContext(ctx);
    ctx_ = nullptr;
    if (heap_ && heapAllocated_) {
        heap_caps_free(heap_);
        heap_ = nullptr;
        heapAllocated_ = 0;
    }
}

PentagotchiPlugins gPlugins;